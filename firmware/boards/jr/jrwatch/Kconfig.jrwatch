## firmware/boards/jr/jrwatch/board.yml
```yaml
board:
  name: jrwatch
  full_name: JRWatch r1
  vendor: jr
  socs:
    - name: nrf52840
```

## firmware/boards/jr/jrwatch/jrwatch_defconfig
```kconfig
# JRWatch board defaults
CONFIG_ARM_MPU=y
CONFIG_HW_STACK_PROTECTION=y

# 32.768 kHz crystal is fitted (Y1, FC-135R class) — LFXO, not RC
CONFIG_CLOCK_CONTROL_NRF_K32SRC_XTAL=y
CONFIG_CLOCK_CONTROL_NRF_K32SRC_20PPM=y

CONFIG_GPIO=y

# no UART pins on this design: console over SEGGER RTT via SWD
CONFIG_SERIAL=n
CONFIG_UART_CONSOLE=n
```
